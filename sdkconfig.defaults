## sdkconfig.defaults
```kconfig
#
# Application-Specific Settings
# Board settings come from boards/xiao_esp32s3_sense/sdkconfig.board
#

# Only put application-specific configs here
# Board hardware configs are in sdkconfig.boardß

# WiFi Configuration - CHANGE THESE!
CONFIG_ESP_WIFI_SSID="Skynetwork"
CONFIG_ESP_WIFI_PASSWORD="Singh408fam"

# Camera
CONFIG_CAMERA_TASK_STACK_SIZE=4096
CONFIG_CAMERA_TASK_PRIORITY=5

# ============================================================================
# Memory Configuration for Camera
# ============================================================================

# Enable PSRAM
CONFIG_ESP_PSRAM=y
CONFIG_ESP_PSRAM_MODE_QUAD=y
CONFIG_ESP_PSRAM_SPEED_80M=y

# PSRAM malloc settings
CONFIG_SPIRAM_USE_CAPS_ALLOC=y
CONFIG_SPIRAM_TRY_ALLOCATE_WIFI_LWIP=y

# Camera framebuffer in PSRAM
CONFIG_CAMERA_FB_IN_PSRAM=y

# Reduce always-internal to minimum
CONFIG_ESP_PSRAM_MALLOC_ALWAYSINTERNAL=4096

# Memory debugging (can remove later)
CONFIG_HEAP_TRACING_STANDALONE=n

# ============================================================================
# PSRAM Configuration - OCTAL MODE for XIAO ESP32S3 Sense
# ============================================================================
CONFIG_ESP_PSRAM=y

# OCTAL mode (not QUAD!)
CONFIG_SPIRAM_MODE_OCT=y
CONFIG_SPIRAM_TYPE_ESPPSRAM64=y

# 40MHz for stability (can try 80MHz later)
CONFIG_SPIRAM_SPEED_40M=y

# Memory allocation
CONFIG_SPIRAM=y
CONFIG_SPIRAM_BOOT_INIT=y
CONFIG_SPIRAM_USE_MALLOC=y

# Reserve only 4KB for internal
CONFIG_SPIRAM_MALLOC_ALWAYSINTERNAL=4096

# PSRAM optimizations
CONFIG_SPIRAM_TRY_ALLOCATE_WIFI_LWIP=y
CONFIG_SPIRAM_USE_CAPS_ALLOC=y
CONFIG_SPIRAM_FETCH_INSTRUCTIONS=y
CONFIG_SPIRAM_RODATA=y
```
